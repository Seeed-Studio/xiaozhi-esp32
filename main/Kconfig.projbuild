## main/Kconfig.projbuild
```kconfig
menu "Xiaozhi Assistant"

config OTA_VERSION_URL
    string "OTA Version URL"
    default "https://api.tenclass.net/xiaozhi/ota/"
    help
        The application will access this URL to check for updates.


choice
    prompt "Language Selection"
    default LANGUAGE_ZH_CN
    help
        Select device display language

    config LANGUAGE_ZH_CN
        bool "Chinese"
    config LANGUAGE_ZH_TW
        bool "Chinese Traditional"
    config LANGUAGE_EN_US
        bool "English"
    config LANGUAGE_JA_JP
        bool "Japanese"
endchoice


choice CONNECTION_TYPE
    prompt "Connection Type"
    default CONNECTION_TYPE_MQTT_UDP
    help
        网络数据传输协议
    config CONNECTION_TYPE_MQTT_UDP
        bool "MQTT + UDP"
    config CONNECTION_TYPE_WEBSOCKET
        bool "Websocket"
endchoice

config WEBSOCKET_URL
    depends on CONNECTION_TYPE_WEBSOCKET
    string "Websocket URL"
    default "wss://api.tenclass.net/xiaozhi/v1/"
    help
        Communication with the server through websocket after wake up.

config WEBSOCKET_ACCESS_TOKEN
    depends on CONNECTION_TYPE_WEBSOCKET
    string "Websocket Access Token"
    default "test-token"
    help
        Access token for websocket communication.

choice BOARD_TYPE
    prompt "Board Type"
    default BOARD_TYPE_SENSECAP_WATCHER
    help
        Board type. 开发板类型
    config BOARD_TYPE_SENSECAP_WATCHER
        bool "SenseCAP Watcher"
endchoice

choice DISPLAY_OLED_TYPE
    depends on BOARD_TYPE_BREAD_COMPACT_WIFI || BOARD_TYPE_BREAD_COMPACT_ML307 || BOARD_TYPE_BREAD_COMPACT_ESP32
    prompt "OLED Type"
    default OLED_SSD1306_128X32
    help
        OLED 屏幕类型选择
    config OLED_SSD1306_128X32
        bool "SSD1306, 分辨率128*32"
    config OLED_SSD1306_128X64
        bool "SSD1306, 分辨率128*64"
    config OLED_SH1106_128X64
        bool "SH1106, 分辨率128*64"
endchoice

choice DISPLAY_LCD_TYPE
    depends on BOARD_TYPE_BREAD_COMPACT_WIFI_LCD || BOARD_TYPE_BREAD_COMPACT_ESP32_LCD || BOARD_TYPE_ESP32_CGC
    prompt "LCD Type"
    default LCD_ST7789_240X320
    help
        屏幕类型选择
    config LCD_ST7789_240X320
        bool "ST7789, 分辨率240*320, IPS"
    config LCD_ST7789_240X320_NO_IPS
        bool "ST7789, 分辨率240*320, 非IPS"
    config LCD_ST7789_170X320
        bool "ST7789, 分辨率170*320"
    config LCD_ST7789_172X320
        bool "ST7789, 分辨率172*320"
    config LCD_ST7789_240X280
        bool "ST7789, 分辨率240*280"
    config LCD_ST7789_240X240
        bool "ST7789, 分辨率240*240"
    config LCD_ST7789_240X240_7PIN
        bool "ST7789, 分辨率240*240, 7PIN"
    config LCD_ST7789_240X135
        bool "ST7789, 分辨率240*135"
    config LCD_ST7735_128X160
        bool "ST7735, 分辨率128*160"
    config LCD_ST7735_128X128
        bool "ST7735, 分辨率128*128"
    config LCD_ST7796_320X480
        bool "ST7796, 分辨率320*480 IPS"
    config LCD_ST7796_320X480_NO_IPS
        bool "ST7796, 分辨率320*480, 非IPS"    
    config LCD_ILI9341_240X320
        bool "ILI9341, 分辨率240*320"
    config LCD_ILI9341_240X320_NO_IPS
        bool "ILI9341, 分辨率240*320, 非IPS"
    config LCD_GC9A01_240X240
        bool "GC9A01, 分辨率240*240, 圆屏"
    config LCD_CUSTOM
        bool "自定义屏幕参数"
endchoice

choice DISPLAY_ESP32S3_KORVO2_V3
    depends on BOARD_TYPE_ESP32S3_KORVO2_V3
    prompt "ESP32S3_KORVO2_V3 LCD Type"
    default LCD_ST7789
    help
        屏幕类型选择
    config LCD_ST7789
        bool "ST7789, 分辨率240*280"
    config LCD_ILI9341
        bool "ILI9341, 分辨率240*320"
endchoice

config USE_WECHAT_MESSAGE_STYLE
    bool "Use WeChat chat interface style"
    default n
    help
        Use WeChat chat interface style

config USE_WAKE_WORD_DETECT
    bool "Enable wake word detection"
    default y
    depends on IDF_TARGET_ESP32S3 && SPIRAM
    help
        Requires ESP32 S3 and AFE support

config USE_AUDIO_PROCESSOR
    bool "Enable audio noise reduction and gain processing"
    default y
    depends on IDF_TARGET_ESP32S3 && SPIRAM
    help
        Requires ESP32 S3 and AFE support

config USE_REALTIME_CHAT
    bool "Enable real-time conversation mode with barge-in (requires AEC support)"
    default n
    depends on USE_AUDIO_PROCESSOR && (BOARD_TYPE_ESP_BOX_3 || BOARD_TYPE_ESP_BOX || BOARD_TYPE_ESP_BOX_LITE || BOARD_TYPE_LICHUANG_DEV || BOARD_TYPE_ESP32S3_KORVO2_V3)
    help
        Requires ESP32 S3 and AEC to be enabled. Due to insufficient performance, it is not recommended to enable it at the same time as the WeChat chat interface style.
        
endmenu
```

## sdkconfig.defaults
```kconfig
CONFIG_COMPILER_CXX_EXCEPTIONS=y
CONFIG_COMPILER_CXX_EXCEPTIONS_EMG_POOL_SIZE=1024

CONFIG_BOOTLOADER_COMPILER_OPTIMIZATION_PERF=y
CONFIG_BOOTLOADER_LOG_LEVEL_NONE=y
CONFIG_BOOTLOADER_SKIP_VALIDATE_ALWAYS=y
CONFIG_BOOTLOADER_APP_ROLLBACK_ENABLE=y

CONFIG_HTTPD_MAX_REQ_HDR_LEN=2048
CONFIG_HTTPD_MAX_URI_LEN=2048

CONFIG_PARTITION_TABLE_CUSTOM=y
# CONFIG_PARTITION_TABLE_CUSTOM_FILENAME="partitions.csv"
CONFIG_PARTITION_TABLE_OFFSET=0x8000

CONFIG_ESP_TASK_WDT_TIMEOUT_S=10
CONFIG_FREERTOS_GENERATE_RUN_TIME_STATS=y
CONFIG_FREERTOS_USE_STATS_FORMATTING_FUNCTIONS=y

CONFIG_ESP_MAIN_TASK_STACK_SIZE=8192
CONFIG_MBEDTLS_DYNAMIC_BUFFER=y
CONFIG_MBEDTLS_SSL_KEEP_PEER_CERTIFICATE=n
CONFIG_ESP_WIFI_IRAM_OPT=n
CONFIG_ESP_WIFI_RX_IRAM_OPT=n
CONFIG_ESP_WIFI_DYNAMIC_RX_MGMT_BUFFER=y

CONFIG_CODEC_I2C_BACKWARD_COMPATIBLE=n

# Fix ML307 FIFO Overflow
CONFIG_UART_ISR_IN_IRAM=y

# LVGL 9.2.2

CONFIG_LV_OS_NONE=y
CONFIG_LV_USE_OS=0
CONFIG_LV_USE_CLIB_MALLOC=y
CONFIG_LV_USE_CLIB_STRING=y
CONFIG_LV_USE_CLIB_SPRINTF=y
CONFIG_LV_USE_IMGFONT=y

# Use compressed font
CONFIG_LV_FONT_FMT_TXT_LARGE=y
CONFIG_LV_USE_FONT_COMPRESSED=y
CONFIG_LV_USE_FONT_PLACEHOLDER=y

# Disable extra widgets to save flash size
CONFIG_LV_USE_ANIMIMG=n
CONFIG_LV_USE_CALENDAR=n
CONFIG_LV_USE_CALENDAR_HEADER_ARROW=n
CONFIG_LV_USE_CALENDAR_HEADER_DROPDOWN=n
CONFIG_LV_USE_CHART=n
CONFIG_LV_USE_KEYBOARD=n
CONFIG_LV_USE_LED=n
CONFIG_LV_USE_LIST=n
CONFIG_LV_USE_MENU=n
CONFIG_LV_USE_MSGBOX=n
CONFIG_LV_USE_SPAN=n
CONFIG_LV_USE_SPINBOX=n
CONFIG_LV_USE_SPINNER=n
CONFIG_LV_USE_TABVIEW=n
CONFIG_LV_USE_TILEVIEW=n
CONFIG_LV_USE_WIN=n

CONFIG_LV_BUILD_EXAMPLES=n

# SenseCAP watcher common config
CONFIG_IDF_TARGET="esp32s3"
CONFIG_ESPTOOLPY_FLASHSIZE_32MB=y
CONFIG_PARTITION_TABLE_CUSTOM_FILENAME="partitions_32M_sensecap.csv"
CONFIG_BOOTLOADER_CACHE_32BIT_ADDR_QUAD_FLASH=y
CONFIG_ESPTOOLPY_FLASH_MODE_AUTO_DETECT=n
CONFIG_IDF_EXPERIMENTAL_FEATURES=y

# SenseCAP watcher Overseas version config
CONFIG_BOARD_TYPE_SENSECAP_WATCHER=y
CONFIG_LANGUAGE_EN_US=y
CONFIG_CONNECTION_TYPE_MQTT_UDP=y
CONFIG_SR_WN_WN9_JARVIS_TTS=y
CONFIG_OTA_URL="https://watcher-agent-api.seeed.cc/xiaozhi/ota/"
```

## sdkconfig.defaults.esp32s3
```kconfig
CONFIG_ESPTOOLPY_FLASHSIZE_16MB=y
CONFIG_ESPTOOLPY_FLASHMODE_QIO=y

CONFIG_ESP_DEFAULT_CPU_FREQ_MHZ_240=y

CONFIG_SPIRAM=y
CONFIG_SPIRAM_MODE_OCT=y
CONFIG_SPIRAM_SPEED_80M=y
CONFIG_SPIRAM_MALLOC_ALWAYSINTERNAL=4096
CONFIG_SPIRAM_TRY_ALLOCATE_WIFI_LWIP=y
CONFIG_SPIRAM_MALLOC_RESERVE_INTERNAL=49152
CONFIG_SPIRAM_MEMTEST=n
CONFIG_MBEDTLS_EXTERNAL_MEM_ALLOC=y

CONFIG_ESP32S3_INSTRUCTION_CACHE_32KB=y
CONFIG_ESP32S3_DATA_CACHE_64KB=y
CONFIG_ESP32S3_DATA_CACHE_LINE_64B=y

CONFIG_SR_WN_WN9_NIHAOXIAOZHI_TTS=y

CONFIG_ESP_SYSTEM_EVENT_TASK_STACK_SIZE=4096


# SenseCAP watcher common config
CONFIG_ESPTOOLPY_FLASHSIZE_32MB=y
CONFIG_PARTITION_TABLE_CUSTOM_FILENAME="partitions_32M_sensecap.csv"
CONFIG_BOOTLOADER_CACHE_32BIT_ADDR_QUAD_FLASH=y
CONFIG_ESPTOOLPY_FLASH_MODE_AUTO_DETECT=n
CONFIG_IDF_EXPERIMENTAL_FEATURES=y

# SenseCAP watcher Overseas version config
CONFIG_BOARD_TYPE_SENSECAP_WATCHER=y
CONFIG_LANGUAGE_EN_US=y
CONFIG_CONNECTION_TYPE_MQTT_UDP=y
CONFIG_SR_WN_WN9_JARVIS_TTS=y
# CONFIG_OTA_VERSION_URL="https://xxx.seeed.cc/xiaozhi/ota" //TODO
```
